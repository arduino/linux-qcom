## Documentation/devicetree/bindings/gpio/waveshare,dsi-touch-gpio.yaml
```yaml
# SPDX-License-Identifier: (GPL-2.0 OR BSD-2-Clause)
%YAML 1.2
---
$id: http://devicetree.org/schemas/gpio/waveshare,dsi-touch-gpio.yaml#
$schema: http://devicetree.org/meta-schemas/core.yaml#

title: Waveshare GPIO controller on DSI TOUCH panels

maintainers:
  - Dmitry Baryshkov <dmitry.baryshkov@oss.qualcomm.com>

description:
  Waveshare DSI TOUCH panel kits contain separate GPIO controller for toggling
  power supplies and panel / touchscreen resets.

properties:
  compatible:
    const: waveshare,dsi-touch-gpio

  reg:
    maxItems: 1

  gpio-controller: true

  '#gpio-cells':
    const: 2

required:
  - compatible
  - reg
  - gpio-controller
  - "#gpio-cells"

additionalProperties: false

examples:
  - |
    #include <dt-bindings/gpio/gpio.h>

    i2c {
        #address-cells = <1>;
        #size-cells = <0>;

        wsgpio: gpio@45 {
            compatible = "waveshare,dsi-touch-gpio";
            reg = <0x45>;
            gpio-controller;
            #gpio-cells = <2>;
        };
    };

    panel_avdd: regulator-panel-avdd {
        compatible = "regulator-fixed";
        regulator-name = "panel-avdd";
        gpios = <&wsgpio 0 GPIO_ACTIVE_HIGH>;
        enable-active-high;
    };

    panel_iovcc: regulator-panel-iovcc {
        compatible = "regulator-fixed";
        regulator-name = "panel-iovcc";
        gpios = <&wsgpio 4 GPIO_ACTIVE_HIGH>;
        enable-active-high;
    };

    panel_vcc: regulator-panel-vcc {
        compatible = "regulator-fixed";
        regulator-name = "panel-vcc";
        gpios = <&wsgpio 8 GPIO_ACTIVE_HIGH>;
        enable-active-high;
        regulator-always-on;
    };

    dsi {
        #address-cells = <1>;
        #size-cells = <0>;

        panel@0 {
            reg = <0>;
            compatible = "waveshare,8.0-dsi-touch-a", "jadard,jd9365da-h3";
            reset-gpios = <&wsgpio 1 GPIO_ACTIVE_LOW>;
            vdd-supply = <&panel_avdd>;
            vccio-supply = <&panel_iovcc>;
            backlight = <&wsgpio>;

            port {
                  panel_in: endpoint {
                      remote-endpoint = <&dsi_out>;
                  };
            };
        };

        port {
            dsi_out: endpoint {
                data-lanes = <0 1 2 3>;
                remote-endpoint = <&panel_in>;
            };
        };
    };
...
```

## Documentation/devicetree/bindings/serial/serial-gpio.yml
```yaml
# SPDX-License-Identifier: GPL-2.0
%YAML 1.2
---
title: GPIO bitbanged UART

maintainers:
  - Riccardo Mereu <r.mereu@arduino.cc>

allOf:
  - $ref: /schemas/serial/serial.yaml#

properties:
  compatible:
    items:
      - const: thinkty,soft_serial

  # Deprecated properties, do not use in new device tree sources:
  serial-gpios:
    minItems: 2
    maxItems: 2
    description: tx and rx gpio, alternative for {tx,rx}-gpios.
                 First one is tx, second one is rx

required:
  - compatible
  - serial-gpios
  - interrupts

unevaluatedProperties: false

examples:
  - |
    bitbanged-uart {
      compatible = "thinkty,soft_serial";
      pinctrl-names = "default";
      pinctrl-0 = <&jmisc_gpio98>, <&jmisc_gpio99>;
      serial-gpios = <&tlmm 99 GPIO_ACTIVE_HIGH>, <&tlmm 98 GPIO_ACTIVE_HIGH>;
      interrupt-parent = <&tlmm>;
      interrupts = <98 IRQ_TYPE_EDGE_FALLING>;

      status = "okay";
    };
```
